## drivers/mmc/Kconfig
```kconfig
#
# MMC subsystem configuration
#

menuconfig MMC
	tristate "MMC/SD/SDIO card support"
	depends on HAS_IOMEM
	help
	  This selects MultiMediaCard, Secure Digital and Secure
	  Digital I/O support.

	  If you want MMC/SD/SDIO support, you should say Y here and
	  also to your specific host controller driver.

config MMC_DEBUG
	bool "MMC debugging"
	depends on MMC != n
	help
	  This is an option for use by developers; most people should
	  say N here.  This enables MMC core and driver debugging.

config MMC_DEBUG_INDIVIDUAL
	bool "Individual MMC debugging (EXPERIMENTAL)"
	depends on MMC_DEBUG != n
	help
	  This is an option for use by developers; most people should
	  say N here.  This enables MMC core and driver debugging for MMC slot individually.

config MMC_DEBUG_CHANNEL
	int "MMC debugging on specific channel (EXPERIMENTAL)"
	range 0 2
	depends on MMC_DEBUG_INDIVIDUAL != n
	default "0"
	help
	  This is an option for use by developers; most people should
	  say N here.  This enables MMC core and driver debugging on specific MMC slot.

if MMC

source "drivers/mmc/core/Kconfig"

source "drivers/mmc/card/Kconfig"

source "drivers/mmc/host/Kconfig"

endif # MMC
```
